#include "PCM.h"
#include <AFMotor.h>
#define L1 A0
#define M1 A1
#define R1 A2

AF_DCMotor motor1(1);
AF_DCMotor motor2(2);
AF_DCMotor motor3(3);
AF_DCMotor motor4(4);
int distance = 500;
int baixo=0;

int lastbuttonstate[] = { LOW, LOW, LOW };
int buttonState[] = { LOW, LOW, LOW };
int buttonPin[] = { A0, A1, A2 };
int comeca = 0;
long loop1;
int speakerpin = A2;
int pose = 0;
const int audio=1250; //tempo do audio

const unsigned char sample[] PROGMEM = {
  125,
  114,
  106,
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  125,
};




void ronronar1() {
  if (digitalRead(buttonPin[0]) == HIGH) {
    if (lastbuttonstate[0] == LOW) {
      delay(50);
    } else {  // the button is being pressed
      buttonState[0] = HIGH;
    }
  } else {  //button pin is low
    buttonState[0] = LOW;
  }
  lastbuttonstate[0] = digitalRead(buttonPin[0]);  //updates last button state


  if (buttonState[0] == LOW) {
    comeca = 0;
    loop1 = millis();
    stopPlayback();
  } else if (buttonState[0] == HIGH && comeca == 0) {
    comeca = 1;
    loop1 = millis();
    startPlayback(sample, sizeof(sample));
    Serial.println("comeca");  //para teste
  }
  if (millis() - loop1 > audio) {  //audio lenght
    comeca = 0;                   //faz loop ao audio
  }
}


void setup() {
  for (int i = 0; i < 3; i++) {
    pinMode(buttonPin[i], INPUT);
  }
  pinMode(speakerpin, OUTPUT);
  startPlayback(sample, sizeof(sample));
  Serial.begin(9600);
 
}

void loop() {
  ronronar1();
}
